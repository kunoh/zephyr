## mcu-project/Kconfig
```kconfig
rsource "drivers/Kconfig"
rsource "modules/Kconfig"
rsource "tests/Kconfig"
rsource "apps/io/Kconfig.logging"
```

## mcu-project/bootloaders/io/boards/mimxrt1060_evk.conf
```kconfig
CONFIG_LOG=y

# The build won't fit on the partition allocated for it without size
# optimizations.
CONFIG_SIZE_OPTIMIZATIONS=y
# Serial
CONFIG_SERIAL=y
CONFIG_UART_LINE_CTRL=y

# MCUboot serial recovery
CONFIG_MCUBOOT_SERIAL=y
CONFIG_BOOT_SERIAL_CDC_ACM=y
# CONFIG_BOOT_SERIAL_DETECT_PIN=0
# CONFIG_BOOT_SERIAL_DETECT_PIN_VAL=0
CONFIG_BOOT_SERIAL_DETECT_DELAY=450
CONFIG_MCUBOOT_INDICATION_LED=y

CONFIG_LOG_BACKEND_UART=y
CONFIG_LOG_BACKEND_RTT=n

# Kconfig overlay for building with RSA signatures
CONFIG_BOOT_SIGNATURE_TYPE_RSA=y

# Use overwrite
CONFIG_BOOT_UPGRADE_ONLY=y

# Use Swap algorithm
CONFIG_BOOT_SWAP_USING_MOVE=n

# Single slot application
#CONFIG_SINGLE_APPLICATION_SLOT=y

# Erase flash as new FW is being uploaded
CONFIG_BOOT_ERASE_PROGRESSIVELY=y

# Disable Zephyr console
CONFIG_CONSOLE=n

# Multithreading
CONFIG_MULTITHREADING=y
```

## mcu-project/drivers/display_lcd_w_framedisk/Kconfig
```kconfig
# Copyright (c) 2019, NXP
# SPDX-License-Identifier: Apache-2.0

config DISPLAY_LCD
	bool "MCUX eLCDIF driver"
	depends on HAS_MCUX_ELCDIF
	help
	  Enable support for mcux eLCDIF driver.

config DISK_DRIVER_FRAMERAM
	bool "FRAMERAM Disk"
	help
	  RAM buffer used to emulate storage disk.
	  This option can be used to test the file
	  system.

config DISPLAY_LCD_W_FRAMEDISK
	bool "MCUX eLCDIF driver"
	depends on HAS_MCUX_ELCDIF
	select DISPLAY_LCD
	select DISK_DRIVER_FRAMERAM
	help
	  Enable support for mcux eLCDIF driver.

if DISPLAY_LCD

config LCD_POOL_BLOCK_NUM
	int "Number of memory pool blocks"
	default 2
	help
	  Number of blocks in the frame buffer memory pool.

config LCD_POOL_BLOCK_MIN
	hex "Minimum memory pool block size"
	default 0x400
	help
	  Minimum block size in the frame buffer memory pool.

config LCD_POOL_BLOCK_MAX
	hex "Maximum memory pool block size"
	default 0x40000
	help
	  Maximum block size in the frame buffer memory pool.

config LCD_POOL_BLOCK_ALIGN
	int "Alignment of memory pool blocks"
	default 64
	help
	  Byte alignment in the frame buffer memory pool.

endif # DISPLAY_LCD

if DISK_DRIVER_FRAMERAM

config DISK_FRAMERAM_VOLUME_SIZE
	int "FRAMERAM Disk size in kilobytes"
	default 96
	help
	  Size of the RAM Disk.

config DISK_FRAMERAM_VOLUME_NAME
	string "FRAMERAM Disk mount point or drive name"
	default "FRAMERAM"
	help
	  Disk name as per file system naming guidelines.

module = FRAMERAM
module-str = framedisk
source "subsys/logging/Kconfig.template.log_config"

endif # DISK_DRIVER_FRAMERAM
```

## mcu-project/drivers/sensors/Kconfig
```kconfig
rsource "nh2054qe34/Kconfig"
rsource "bq25713/Kconfig"
rsource "scl3300/Kconfig"
```

## mcu-project/drivers/sensors/bq25713/Kconfig
```kconfig
config BATTERY_CHARGER_BQ25713
	bool "bq25713 driver"
	
	help
	  Enable support for BQ25713 Smart Battery Charger driver.
```

## mcu-project/drivers/sensors/nh2054qe34/Kconfig
```kconfig
config BATTERY_NH2054QE34
	bool "nh2054qe34 driver"
	
	help
	  Enable support for NH2054QE34 Smart Battery driver.
```

## mcu-project/drivers/sensors/scl3300/Kconfig
```kconfig
config INCL_SCL3300
	bool "scl3300 driver"
	
	help
	  Enable support for SCL3300 inclinometer driver.
```

## mcu-project/dts/bindings/Sensors/murata,scl3300.yml
```yaml
description: SCL3300 high precision inclinometer.

compatible: "murata,scl3300"

include: spi-device.yaml

properties:
  pcs-sck-delay:
    type: int
  sck-pcs-delay:
    type: int
```

## mcu-project/dts/bindings/inspired_energy,nh2054qe34.yaml
```yaml
description: Inspired Energy NH2054QE34 Smart battery

compatible: "inspiredenergy,nh2054qe34"

include: i2c-device.yaml
```

## mcu-project/dts/bindings/ti,bq25700a.yaml
```yaml
description: Texas Instruments BQ25713 Smart Battery Charger

compatible: "ti,bq25713"

include: i2c-device.yaml
```

## mcu-project/modules/Kconfig
```kconfig
rsource "tm_hello_module/Kconfig"
rsource "event_mgr/Kconfig"
rsource "message_handler/Kconfig"
```

## mcu-project/modules/display_lcd/Kconfig
```kconfig
# Copyright (c) 2019, NXP
# SPDX-License-Identifier: Apache-2.0

config DISPLAY_LCD
	bool "MCUX eLCDIF driver"
	depends on HAS_MCUX_ELCDIF
	help
	  Enable support for mcux eLCDIF driver.

if DISPLAY_LCD

config LCD_POOL_BLOCK_NUM
	int "Number of memory pool blocks"
	default 2
	help
	  Number of blocks in the frame buffer memory pool.

config LCD_POOL_BLOCK_MIN
	hex "Minimum memory pool block size"
	default 0x400
	help
	  Minimum block size in the frame buffer memory pool.

config LCD_POOL_BLOCK_MAX
	hex "Maximum memory pool block size"
	default 0x40000
	help
	  Maximum block size in the frame buffer memory pool.

config LCD_POOL_BLOCK_ALIGN
	int "Alignment of memory pool blocks"
	default 64
	help
	  Byte alignment in the frame buffer memory pool.

endif # DISPLAY_LCD
```

## mcu-project/modules/event_mgr/Kconfig
```kconfig
config  TM_EVENT_MGR
	bool "Event manager"
	help
	  TM Event manager for communication between MCU modules, MCU and Linux and MCUs

config TM_EVENT_QUEUE_SIZE
       int "Event queue size"
       default 10
       range 1 30
          help
	    Size of the event queue
```

## mcu-project/modules/framedisk/Kconfig
```kconfig
# Copyright (c) 2016 Intel Corporation
# SPDX-License-Identifier: Apache-2.0

config DISK_DRIVER_FRAMERAM
	bool "FRAMERAM Disk"
	help
	  RAM buffer used to emulate storage disk.
	  This option can be used to test the file
	  system.

if DISK_DRIVER_FRAMERAM

config DISK_FRAMERAM_VOLUME_SIZE
	int "FRAMERAM Disk size in kilobytes"
	default 96
	help
	  Size of the RAM Disk.

config DISK_FRAMERAM_VOLUME_NAME
	string "FRAMERAM Disk mount point or drive name"
	default "FRAMERAM"
	help
	  Disk name as per file system naming guidelines.

module = FRAMERAM
module-str = framedisk
source "subsys/logging/Kconfig.template.log_config"

endif # DISK_DRIVER_FRAMERAM
```

## mcu-project/modules/message_handler/Kconfig
```kconfig
config MESSAGE_HANDLER
	bool "Message handler and dispatcher"
	select NANOPB
	help
	  Message handler and dispatcher
```

## mcu-project/tests/io/managers/battery/testcase.yaml
```yaml
tests:
  manager.battery:
    platform_allow: native_posix native_posix_64
    extra_args: CONF_FILE="test_battery.conf"
    tags: testing
```

## mcu-project/tests/io/managers/inclinometer/testcase.yaml
```yaml
tests:
  manager.inclino:
    platform_allow: native_posix native_posix_64
    extra_args: CONF_FILE="test_inclino.conf"
    tags: testing
```

## mcu-project/tests/io/message/dispatcher/testcase.yaml
```yaml
# This file is used to define the possibly multiple different test configuration 
# for which the tests in the current directory should be build and run.

tests:
  message.dispatcher.message_chain:
    platform_allow: native_posix native_posix_64
    tags: message_dispatching_chain
    extra_args: CONF_FILE="test_dispatcher.conf"
```

## mcu-project/tests/message/handlers/testcase.yaml
```yaml
# This file is used to define the possibly multiple different test configuration 
# for which the tests in the current directory should be build and run.

# Example
# tests:
#   bluetooth.gatt:
#     build_only: true
#     platform_allow: qemu_cortex_m3 qemu_x86
#     tags: bluetooth
#   bluetooth.gatt.br:
#     build_only: true
#     extra_args: CONF_FILE="prj_br.conf"
#     filter: not CONFIG_DEBUG
#     platform_exclude: up_squared
#     platform_allow: qemu_cortex_m3 qemu_x86
#     tags: bluetooth

tests:
  message.handlers:
    platform_allow: native_posix native_posix_64
    extra_args: CONF_FILE="test_handlers.conf"
    tags: message_handlers
```

## mcu-project/tests/message/testcase.yaml
```yaml
tests:
  message_version.unit.test1:
    platform_allow: native_posix native_posix_64
    tags: message_version unit
```

## mcu-project/tests/tm_hello/testcase.yaml
```yaml
tests:
  tm_hello_module.unit.test1:
    platform_allow: native_posix native_posix_64
    tags: tm_hello_module unit
```

## mcu-project/west.yml
```yaml
manifest:
  version: "0.13"
  remotes:
    - name: zephyrproject
      url-base: https://github.com/kunoh
  defaults:
    remote: zephyrproject

  projects:
    - name: zephyr
      repo-path: zephyr
      path: zephyr
      revision: user_allocation_off_ramdisk_buffer
      import:
        path-prefix: zephyrproject
  self:
    path: mcu-project
```
