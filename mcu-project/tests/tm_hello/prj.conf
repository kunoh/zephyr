## CMakeLists.txt
```
cmake_minimum_required(VERSION 3.20.0)

find_package(Zephyr REQUIRED HINTS $ENV{ZEPHYR_BASE})
project(tm_hello_module_test)

FILE(GLOB app_sources src/*.c)

target_sources(app PRIVATE
  ${app_sources}
  )
```

## prj.conf
```kconfig
CONFIG_ZTEST=y
CONFIG_TM_HELLO_MODULE=y
```

## src/main.c
```c
#include <zephyr/ztest.h>
#include "tm_hello_module.h"

void test_return_arg(void)
{
    zassert_equal(return_arg(7), 7, "return_aarg unexpected result");
}

void test_main(void)
{
	ztest_test_suite(tm_hello_module_unit_tests,
			 ztest_unit_test(test_return_arg)
	);
	ztest_run_test_suite(tm_hello_module_unit_tests);
}
```
